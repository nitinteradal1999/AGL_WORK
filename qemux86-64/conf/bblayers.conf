## qemux86-64/conf/bblayers.conf
```bitbake
# LAYER_CONF_VERSION is increased each time build/conf/bblayers.conf
# changes incompatibly
LCONF_VERSION = "6"

BBPATH = "${TOPDIR}"
BBFILES ?= ""

# Convenience variables usable in various configuration fragments
#----------------------------------
BCONFDIR := "${@os.path.abspath(os.path.dirname(d.getVar('FILE', True)))}"
METADIR  := "${@os.path.abspath('/home/ngx/AGL/pike/external/poky/../..')}"

# These are the core OE + YP Layers
#----------------------------------
YOCTO_LAYERS = " \
  ${METADIR}/external/poky/meta \
  ${METADIR}/external/poky/meta-poky \
  ${METADIR}/external/meta-lts-mixins_rust-1.68 \
  "
#  this is added for the boards where necessary, not globally
#  ${METADIR}/external/poky/meta-yocto-bsp \
#
# These are the AGL CORE Layers that make up the basis
# - they create a minimal bootable filesystem
#   with some automotive tools/libraries
#-----------------------------------------------------
AGL_CORE_LAYERS = " \
  ${METADIR}/meta-agl/meta-agl-core \
  ${METADIR}/meta-agl/meta-agl-bsp \
  "

# These are the direct dependencies of the AGL CORE Layers
#---------------------------------------------------------
AGL_CORE_DEPENDENCY_LAYERS = " \
  ${METADIR}/external/meta-openembedded/meta-oe \
  "

# Indirection to avoid duplicate inclusions of the same folder into BBLAYERS
# the evaluation is in the bblayers.conf.sample in meta-agl/templates/base
AGL_META_NETWORKING ?= ""
AGL_META_PYTHON ?= ""
AGL_META_FILESYSTEMS ?= ""
AGL_META_MULTIMEDIA ?= ""
AGL_META_VIRTUALIZATION ?= ""
AGL_META_CLANG ?= ""
AGL_META_QT5 ?= ""

AGL_OTHER_DEPENDENCY_LAYERS = " \
    ${AGL_META_NETWORKING} \
    ${AGL_META_PYTHON} \
    ${AGL_META_FILESYSTEMS} \
    ${AGL_META_MULTIMEDIA} \
    ${AGL_META_VIRTUALIZATION} \
    ${AGL_META_CLANG} \
    ${AGL_META_QT5} \
    "

####################
# Combine the layers
BBLAYERS ?= " \
  ${AGL_OTHER_DEPENDENCY_LAYERS} \
  ${AGL_CORE_DEPENDENCY_LAYERS} \
  ${AGL_CORE_LAYERS} \
  ${YOCTO_LAYERS} \
  "

BBLAYERS_NON_REMOVABLE ?= " \
  ${METADIR}/external/poky/meta \
  ${METADIR}/external/poky/meta-poky \
  ${METADIR}/meta-agl/meta-agl-core \
  "




# # # # # # # # # # # # # # # # # # # # # # # # # # # # # # # # # # # # # # # #
# fragment { 
# /home/ngx/AGL/pike/meta-agl-demo/templates/feature/agl-demo/50_bblayers.conf.inc
#
# This layer contains the WIP feature/demo code only
#---------------------------------------------------
BBLAYERS =+ " \
   ${METADIR}/meta-agl-demo \
"

AGL_META_FILESYSTEMS = "${METADIR}/external/meta-openembedded/meta-filesystems"
AGL_META_MULTIMEDIA = "${METADIR}/external/meta-openembedded/meta-multimedia"
AGL_META_NETWORKING = "${METADIR}/external/meta-openembedded/meta-networking"
AGL_META_PYTHON = "${METADIR}/external/meta-openembedded/meta-python"
AGL_META_QT5 = "${METADIR}/external/meta-qt5"

# Chromium recipes do still require python2
BBLAYERS =+ " \
   ${METADIR}/external/meta-python2 \
"

#
# }
# # # # # # # # # # # # # # # # # # # # # # # # # # # # # # # # # # # # # # # #

# # # # # # # # # # # # # # # # # # # # # # # # # # # # # # # # # # # # # # # #
# fragment { 
# /home/ngx/AGL/pike/meta-agl-devel/templates/feature/agl-flutter/50_bblayers.conf.inc
#
AGL_META_CLANG = " ${METADIR}/external/meta-clang "

BBLAYERS =+ " \
   ${METADIR}/meta-agl-devel/meta-agl-flutter \
   ${METADIR}/external/meta-flutter \
"

#
# }
# # # # # # # # # # # # # # # # # # # # # # # # # # # # # # # # # # # # # # # #

# # # # # # # # # # # # # # # # # # # # # # # # # # # # # # # # # # # # # # # #
# fragment { 
# /home/ngx/AGL/pike/meta-agl/templates/feature/agl-app-framework/50_bblayers.conf.inc
#

BBLAYERS =+ " \
	${METADIR}/meta-agl/meta-app-framework \
	"

#
# }
# # # # # # # # # # # # # # # # # # # # # # # # # # # # # # # # # # # # # # # #

# # # # # # # # # # # # # # # # # # # # # # # # # # # # # # # # # # # # # # # #
# fragment { 
# /home/ngx/AGL/pike/meta-agl/templates/feature/agl-pipewire/50_bblayers.conf.inc
#

BBLAYERS =+ " \
	${METADIR}/meta-agl/meta-pipewire \
	"

# we ship our own pipewire
BBMASK += "meta-openembedded/meta-oe/recipes-multimedia/pipewire/"

#
# }
# # # # # # # # # # # # # # # # # # # # # # # # # # # # # # # # # # # # # # # #

# # # # # # # # # # # # # # # # # # # # # # # # # # # # # # # # # # # # # # # #
# fragment { 
# /home/ngx/AGL/pike/meta-agl/templates/feature/agl-selinux/50_bblayers.conf.inc
#
AGL_META_PYTHON = "${METADIR}/external/meta-openembedded/meta-python"

BBLAYERS =+ " \
	${METADIR}/external/meta-selinux \
	"

#
# }
# # # # # # # # # # # # # # # # # # # # # # # # # # # # # # # # # # # # # # # #
```
